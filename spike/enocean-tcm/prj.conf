## CMakeLists.txt
```
cmake_minimum_required(VERSION 3.20.0)

find_package(Zephyr REQUIRED HINTS $ENV{ZEPHYR_BASE})
project(enocean_tcm)

target_sources(app PRIVATE src/main.c src/esp3.c src/eep.c)
```

## prj.conf
```kconfig
# TCM on a UART, interrupt-driven receive
CONFIG_SERIAL=y
CONFIG_UART_INTERRUPT_DRIVEN=y
CONFIG_RING_BUFFER=y

# Shell on the console (J-Link VCOM on the DK)
CONFIG_SHELL=y
CONFIG_SHELL_PROMPT_UART="enocean:~$ "
CONFIG_LOG=y

CONFIG_MAIN_STACK_SIZE=2048
```

## boards/nrf52840dk_nrf52840.overlay
```dts
/*
 * TCM 310/515 (EnOcean Pi hat) on UART1: P1.02 = TX to the module, P1.01 = RX from it
 * (Arduino header D1/D0). Pins come from the board's arduino_serial pinctrl.
 * UART0 stays the console on the J-Link USB port.
 */

/ {
	chosen {
		enocean,uart = &uart1;
	};
};

&uart1 {
	status = "okay";
	current-speed = <57600>;
};
```

## src/main.c
```c
/*
 * EnOcean spike: a TCM 310/515 (for example on an EnOcean Pi hat) on a UART of the nRF52840.
 * Logs every radio telegram, decodes the common profiles and offers a few shell commands.
 * No Matter yet; this is to see how the devices at hand behave.
 */

#include "eep.h"
#include "esp3.h"

#include <zephyr/device.h>
#include <zephyr/drivers/uart.h>
#include <zephyr/kernel.h>
#include <zephyr/shell/shell.h>
#include <zephyr/sys/printk.h>
#include <zephyr/sys/ring_buffer.h>

#include <stdarg.h>
#include <stdlib.h>
#include <string.h>

static const struct device *const tcm = DEVICE_DT_GET(DT_CHOSEN(enocean_uart));

/* --- Receive: ISR into a ring buffer, a thread decodes --- */

RING_BUF_DECLARE(rx_ring, 512);
static K_SEM_DEFINE(rx_sem, 0, 1);
static uint32_t rx_overruns;

static void uart_isr(const struct device *dev, void *user_data)
{
	ARG_UNUSED(user_data);

	while (uart_irq_update(dev) && uart_irq_is_pending(dev)) {
		if (!uart_irq_rx_ready(dev)) {
			continue;
		}

		uint8_t buf[32];
		int n = uart_fifo_read(dev, buf, sizeof(buf));

		if (n > 0) {
			if (ring_buf_put(&rx_ring, buf, n) < (uint32_t)n) {
				rx_overruns++;
			}
			k_sem_give(&rx_sem);
		}
	}
}

/* --- Transmit: one command at a time, the response is matched to it --- */

static K_MUTEX_DEFINE(tx_lock);
static volatile uint8_t pending_cmd; /* common command awaiting a response, 0 = none */

static volatile uint32_t base_id; /* from CO_RD_IDBASE at start, 0 = not read yet */

/* pending: the common command the response belongs to, 0 for a radio telegram */
static void send_frame(const uint8_t *frame, size_t n, uint8_t pending)
{
	k_mutex_lock(&tx_lock, K_FOREVER);
	pending_cmd = pending;
	for (size_t i = 0; i < n; i++) {
		uart_poll_out(tcm, frame[i]);
	}
	k_mutex_unlock(&tx_lock);
}

static int send_common_command(uint8_t cmd)
{
	uint8_t frame[16];
	size_t n = esp3_encode(ESP3_COMMON_COMMAND, &cmd, 1, NULL, 0, frame, sizeof(frame));

	send_frame(frame, n, cmd);
	return 0;
}

/* --- The actuators taught in to this TCM (from the enocean-mqtt config on the Pi) --- */

enum actuator_kind {
	ACT_ELTAKO, /* taught to a rocker; reports its state as F6 telegrams */
	ACT_D2_01,  /* VLD electronic switch, addressed commands */
};

struct actuator {
	uint32_t id;
	const char *name;
	enum actuator_kind kind;
	uint8_t offset; /* sender ID = base ID + offset, as taught in */
};

static const struct actuator actuators[] = {
	{0x0190B727, "kueche_links", ACT_ELTAKO, 7},
	{0x018B3A28, "kueche_rechts", ACT_ELTAKO, 3},
	{0x0188EA75, "flur", ACT_ELTAKO, 6},
	{0x05017E43, "kueche_radio", ACT_D2_01, 9},
};

static const struct actuator *actuator_by_id(uint32_t id)
{
	for (size_t i = 0; i < ARRAY_SIZE(actuators); i++) {
		if (actuators[i].id == id) {
			return &actuators[i];
		}
	}
	return NULL;
}

static const struct actuator *actuator_by_name(const char *name)
{
	for (size_t i = 0; i < ARRAY_SIZE(actuators); i++) {
		if (strcmp(actuators[i].name, name) == 0) {
			return &actuators[i];
		}
	}
	return NULL;
}

/* --- Devices heard, with the profile they use (learned from teach-in or set in the shell) --- */

#define MAX_DEVICES 32

struct device_entry {
	uint32_t id;
	uint8_t rorg;
	struct eep eep; /* rorg 0 = not known */
	uint32_t count;
	int8_t dbm;
	int64_t last_ms;
};

static struct device_entry devices[MAX_DEVICES];
static K_MUTEX_DEFINE(devices_lock);

/* Caller holds devices_lock. Returns NULL if the table is full. */
static struct device_entry *device_get(uint32_t id, bool create)
{
	struct device_entry *free_slot = NULL;

	for (size_t i = 0; i < MAX_DEVICES; i++) {
		if (devices[i].id == id) {
			return &devices[i];
		}
		if (!free_slot && devices[i].id == 0) {
			free_slot = &devices[i];
		}
	}
	if (create && free_slot) {
		memset(free_slot, 0, sizeof(*free_slot));
		free_slot->id = id;
	}
	return create ? free_slot : NULL;
}

/* --- Printing ---
 *
 * Lines are assembled here and printed in one piece; printed in parts, the shell would put its
 * prompt in between. Only the receive thread and main() (before any radio traffic) use it.
 */

static char line[192];
static size_t line_len;

static void out(const char *fmt, ...)
{
	va_list ap;

	va_start(ap, fmt);
	int n = vsnprintk(&line[line_len], sizeof(line) - line_len, fmt, ap);
	va_end(ap);

	if (n > 0) {
		line_len = MIN(line_len + (size_t)n, sizeof(line) - 1);
	}
	if (line_len && line[line_len - 1] == '\n') {
		printk("%s", line);
		line_len = 0;
	}
}

static const char *centi(int32_t v, char *buf, size_t size)
{
	uint32_t a = (uint32_t)(v < 0 ? -v : v);

	snprintk(buf, size, "%s%u.%02u", v < 0 ? "-" : "", a / 100, a % 100);
	return buf;
}

static void print_rocker(const struct erp1 *t)
{
	struct eep_rocker r;

	if (!eep_f6_02(t, &r)) {
		return;
	}
	if (!r.pressed) {
		out(" | rocker released\n");
	} else if (r.known && r.second) {
		out(" | rocker %s + %s pressed\n", eep_rocker_button_name(r.button),
		       eep_rocker_button_name(r.button2));
	} else if (r.known) {
		out(" | rocker %s pressed\n", eep_rocker_button_name(r.button));
	} else {
		out(" | rocker: %u buttons pressed\n", r.count);
	}
}

static void print_4bs(const struct erp1 *t, const struct eep *known)
{
	char a[12], b[12];
	struct eep eep;
	uint16_t manufacturer;
	int16_t c;
	uint16_t rh;
	bool has_temp;

	if (eep_4bs_is_teach_in(t)) {
		if (eep_4bs_teach_in(t, &eep, &manufacturer)) {
			out(" | teach-in A5-%02X-%02X, manufacturer %03X\n", eep.func, eep.type,
			       manufacturer);
		} else {
			out(" | teach-in without profile (set it: tcm profile %08X A5-xx-xx)\n",
			       t->sender);
		}
		return;
	}

	if (known->rorg == EEP_RORG_4BS && known->func == 0x02 &&
	    eep_a5_02(known->type, t, &c)) {
		out(" | A5-02-%02X: %s C\n", known->type, centi(c, a, sizeof(a)));
		return;
	}
	if (known->rorg == EEP_RORG_4BS && known->func == 0x04 &&
	    eep_a5_04(known->type, t, &rh, &c, &has_temp)) {
		out(" | A5-04-%02X: %s %%", known->type, centi(rh, a, sizeof(a)));
		if (has_temp) {
			out(", %s C", centi(c, b, sizeof(b)));
		}
		out("\n");
		return;
	}
	if (known->rorg) {
		out(" | %02X-%02X-%02X not decoded yet\n", known->rorg, known->func,
		       known->type);
		return;
	}

	/* Profile not known: show the two most common readings as a hint */
	out(" | profile unknown;");
	if (eep_a5_02(0x05, t, &c)) {
		out(" as A5-02-05: %s C;", centi(c, a, sizeof(a)));
	}
	if (eep_a5_04(0x01, t, &rh, &c, &has_temp)) {
		out(" as A5-04-01: %s %%, %s C", centi(rh, a, sizeof(a)),
		       centi(c, b, sizeof(b)));
	}
	out("\n");
}

static void print_contact(const struct erp1 *t)
{
	bool closed, teach_in;

	if (!eep_d5_00_01(t, &closed, &teach_in)) {
		return;
	}
	if (teach_in) {
		out(" | contact teach-in (D5-00-01)\n");
	} else {
		out(" | contact %s\n", closed ? "closed" : "open");
	}
}

static void print_ute(const struct erp1 *t)
{
	struct eep_ute u;
	static const char *const request[] = {"teach-in", "teach-out", "teach-in/out", "?"};

	if (!eep_ute(t, &u)) {
		return;
	}
	out(" | UTE %s %s, %s, EEP %02X-%02X-%02X, manufacturer %03X, channels %u\n",
	       u.command == 0 ? "query" : "response", request[u.request],
	       u.bidirectional ? "bidirectional" : "unidirectional", u.eep.rorg, u.eep.func,
	       u.eep.type, u.manufacturer, u.channels);
}

static void print_d2_01(const struct actuator *act, const struct erp1 *t)
{
	struct eep_d2_01_status st;
	struct eep_d2_01_measurement m;

	if (eep_d2_01_status(t, &st)) {
		if (st.output == EEP_D2_01_OUTPUT_INVALID) {
			out(" | %s channel %u: output not valid\n", act->name, st.channel);
		} else {
			out(" | %s channel %u: %s (%u %%)%s%s\n", act->name, st.channel,
			    st.output ? "on" : "off", st.output,
			    st.local_control ? ", local control" : "",
			    st.power_failure ? ", power failure" : "");
		}
	} else if (eep_d2_01_measurement(t, &m)) {
		out(" | %s channel %u: %u %s\n", act->name, m.channel, m.value,
		    eep_d2_01_unit_name(m.unit));
	} else {
		out(" | %s: D2-01 command %d\n", act->name, eep_d2_01_command(t));
	}
}

static void handle_radio(const struct esp3_packet *pkt)
{
	struct erp1 t;
	struct eep known = {0};

	if (!erp1_parse(pkt, &t)) {
		out("ERP1 too short (%u bytes)\n", pkt->data_len);
		return;
	}

	k_mutex_lock(&devices_lock, K_FOREVER);
	struct device_entry *d = device_get(t.sender, true);

	if (d) {
		struct eep learned;
		uint16_t manufacturer;

		d->rorg = t.rorg;
		d->count++;
		d->dbm = t.dbm;
		d->last_ms = k_uptime_get();
		if (eep_4bs_teach_in(&t, &learned, &manufacturer)) {
			d->eep = learned;
		}
		known = d->eep;
	}
	k_mutex_unlock(&devices_lock);

	out("%08X %02X", t.sender, t.rorg);
	for (uint8_t i = 0; i < t.payload_len; i++) {
		out(i ? "%02X" : " %02X", t.payload[i]);
	}
	out(" st=%02X %ddBm", t.status, t.dbm);
	if (t.subtel > 1) {
		out(" x%u", t.subtel);
	}
	if (t.dest != EEP_ID_BROADCAST) {
		out(" to %08X", t.dest);
	}
	if (t.security) {
		out(" sec=%u", t.security);
	}

	const struct actuator *act = actuator_by_id(t.sender);

	if (act && act->kind == ACT_ELTAKO && t.rorg == EEP_RORG_RPS && t.payload_len == 1) {
		/* Eltako status: the "O" half of either rocker (0x30, 0x70) means on */
		out(" | %s %s\n", act->name, (t.payload[0] & 0x20) ? "on" : "off");
		return;
	}
	if (act && act->kind == ACT_D2_01 && t.rorg == EEP_RORG_VLD) {
		print_d2_01(act, &t);
		return;
	}

	switch (t.rorg) {
	case EEP_RORG_RPS:
		print_rocker(&t);
		break;
	case EEP_RORG_1BS:
		print_contact(&t);
		break;
	case EEP_RORG_4BS:
		print_4bs(&t, &known);
		break;
	case EEP_RORG_UTE:
		print_ute(&t);
		break;
	default:
		out("\n");
		break;
	}
}

static void handle_response(const struct esp3_packet *pkt)
{
	const uint8_t *d = esp3_data(pkt);
	uint8_t cmd = pending_cmd;

	pending_cmd = 0;
	if (pkt->data_len < 1) {
		return;
	}
	if (d[0] != ESP3_RET_OK) {
		out("TCM: command %02X failed, return code %02X\n", cmd, d[0]);
		return;
	}

	switch (cmd) {
	case ESP3_CO_RD_VERSION:
		if (pkt->data_len >= 33) {
			char desc[17];

			memcpy(desc, &d[17], 16);
			desc[16] = '\0';
			out("TCM: app %u.%u.%u.%u, API %u.%u.%u.%u, chip ID %02X%02X%02X%02X, "
			       "\"%s\"\n",
			       d[1], d[2], d[3], d[4], d[5], d[6], d[7], d[8], d[9], d[10], d[11],
			       d[12], desc);
		}
		break;
	case ESP3_CO_RD_IDBASE:
		if (pkt->data_len >= 5) {
			base_id = ((uint32_t)d[1] << 24) | ((uint32_t)d[2] << 16) |
				  ((uint32_t)d[3] << 8) | d[4];
			out("TCM: base ID %02X%02X%02X%02X", d[1], d[2], d[3], d[4]);
			if (pkt->opt_len >= 1) {
				out(", %u base ID changes left", esp3_opt(pkt)[0]);
			}
			out("\n");
		}
		break;
	default:
		out("TCM: OK\n");
		break;
	}
}

static void handle_packet(const struct esp3_packet *pkt)
{
	switch (pkt->type) {
	case ESP3_RADIO_ERP1:
		handle_radio(pkt);
		break;
	case ESP3_RESPONSE:
		handle_response(pkt);
		break;
	case ESP3_EVENT:
		out("TCM event %02X\n", pkt->data_len ? esp3_data(pkt)[0] : 0);
		break;
	default:
		out("ESP3 packet type %02X, %u + %u bytes\n", pkt->type, pkt->data_len,
		       pkt->opt_len);
		break;
	}
}

static struct esp3_decoder decoder;

static void rx_thread(void *a, void *b, void *c)
{
	ARG_UNUSED(a);
	ARG_UNUSED(b);
	ARG_UNUSED(c);

	for (;;) {
		uint8_t buf[64];
		uint32_t n;

		k_sem_take(&rx_sem, K_FOREVER);
		while ((n = ring_buf_get(&rx_ring, buf, sizeof(buf))) > 0) {
			for (uint32_t i = 0; i < n; i++) {
				if (esp3_decoder_feed(&decoder, buf[i])) {
					handle_packet(&decoder.pkt);
				}
			}
		}
	}
}

K_THREAD_DEFINE(rx_tid, 2048, rx_thread, NULL, NULL, NULL, 5, 0, 0);

/* --- Shell --- */

static int cmd_version(const struct shell *sh, size_t argc, char **argv)
{
	ARG_UNUSED(argc);
	ARG_UNUSED(argv);
	shell_print(sh, "asking the TCM for its version");
	return send_common_command(ESP3_CO_RD_VERSION);
}

static int cmd_idbase(const struct shell *sh, size_t argc, char **argv)
{
	ARG_UNUSED(argc);
	ARG_UNUSED(argv);
	shell_print(sh, "asking the TCM for its base ID");
	return send_common_command(ESP3_CO_RD_IDBASE);
}

static int cmd_devices(const struct shell *sh, size_t argc, char **argv)
{
	ARG_UNUSED(argc);
	ARG_UNUSED(argv);
	int64_t now = k_uptime_get();

	k_mutex_lock(&devices_lock, K_FOREVER);
	for (size_t i = 0; i < MAX_DEVICES; i++) {
		const struct device_entry *d = &devices[i];

		if (!d->id) {
			continue;
		}

		const struct actuator *act = actuator_by_id(d->id);

		if (act) {
			shell_print(sh, "%08X  %02X  %-13s %4u telegrams  %4d dBm  %us ago", d->id,
				    d->rorg, act->name, d->count, d->dbm,
				    (uint32_t)((now - d->last_ms) / 1000));
		} else if (d->eep.rorg) {
			shell_print(sh, "%08X  %02X  %02X-%02X-%02X  %4u telegrams  %4d dBm  %us ago",
				    d->id, d->rorg, d->eep.rorg, d->eep.func, d->eep.type, d->count,
				    d->dbm, (uint32_t)((now - d->last_ms) / 1000));
		} else {
			shell_print(sh, "%08X  %02X  ?           %4u telegrams  %4d dBm  %us ago",
				    d->id, d->rorg, d->count, d->dbm, (uint32_t)((now - d->last_ms) / 1000));
		}
	}
	k_mutex_unlock(&devices_lock);
	return 0;
}

static int cmd_profile(const struct shell *sh, size_t argc, char **argv)
{
	ARG_UNUSED(argc);
	char *end;
	uint32_t id = strtoul(argv[1], &end, 16);
	unsigned int rorg, func, type;

	if (*end || !id || sscanf(argv[2], "%x-%x-%x", &rorg, &func, &type) != 3 || rorg > 0xFF ||
	    func > 0xFF || type > 0xFF) {
		shell_error(sh, "usage: tcm profile <sender id, hex> <EEP, e.g. A5-02-05>");
		return -EINVAL;
	}

	k_mutex_lock(&devices_lock, K_FOREVER);
	struct device_entry *d = device_get(id, true);

	if (d) {
		d->eep = (struct eep){.rorg = rorg, .func = func, .type = type};
	}
	k_mutex_unlock(&devices_lock);

	if (!d) {
		shell_error(sh, "device table full");
		return -ENOMEM;
	}
	shell_print(sh, "%08X uses %02X-%02X-%02X", id, rorg, func, type);
	return 0;
}

static int cmd_stats(const struct shell *sh, size_t argc, char **argv)
{
	ARG_UNUSED(argc);
	ARG_UNUSED(argv);

	/* Counters are only written by the receive thread; a slightly stale copy is fine. */
	struct esp3_stats s = decoder.stats;

	shell_print(sh, "packets %u, header CRC errors %u, data CRC errors %u, oversize %u, "
			"skipped bytes %u, UART overruns %u",
		    s.packets, s.header_crc_errors, s.data_crc_errors, s.oversize,
		    s.skipped_bytes, rx_overruns);
	return 0;
}

static int cmd_switch(const struct shell *sh, size_t argc, char **argv)
{
	ARG_UNUSED(argc);
	const struct actuator *act = actuator_by_name(argv[1]);
	bool on = strcmp(argv[2], "on") == 0;
	bool status = strcmp(argv[2], "status") == 0;
	uint8_t frame[48];
	size_t n;

	if (!act || (!on && !status && strcmp(argv[2], "off") != 0)) {
		shell_error(sh, "usage: tcm switch <name> on|off|status");
		for (size_t i = 0; i < ARRAY_SIZE(actuators); i++) {
			shell_print(sh, "  %s", actuators[i].name);
		}
		return -EINVAL;
	}
	if (!base_id) {
		shell_error(sh, "base ID not known yet; run tcm idbase");
		return -EAGAIN;
	}

	uint32_t sender = base_id + act->offset;

	if (act->kind == ACT_ELTAKO) {
		if (status) {
			shell_error(sh, "Eltako actuators report only when they switch");
			return -ENOTSUP;
		}
		n = eep_eltako_switch(sender, on, frame, sizeof(frame));
	} else if (status) {
		n = eep_d2_01_query_status(sender, act->id, EEP_D2_01_ALL_CHANNELS, frame,
					   sizeof(frame));
	} else {
		n = eep_d2_01_set_output(sender, act->id, 0, on ? 100 : 0, frame, sizeof(frame));
	}

	shell_print(sh, "%s %s from %08X", act->name, argv[2], sender);
	send_frame(frame, n, 0);
	return 0;
}

SHELL_STATIC_SUBCMD_SET_CREATE(
	tcm_cmds, SHELL_CMD(version, NULL, "Read the TCM's firmware version", cmd_version),
	SHELL_CMD(idbase, NULL, "Read the TCM's base ID (for sending)", cmd_idbase),
	SHELL_CMD(devices, NULL, "Senders heard, with their profile", cmd_devices),
	SHELL_CMD_ARG(profile, NULL, "<id> <EEP>: set a sender's profile, e.g. A5-02-05",
		      cmd_profile, 3, 0),
	SHELL_CMD_ARG(switch, NULL, "<name> on|off|status: switch a taught-in actuator",
		      cmd_switch, 3, 0),
	SHELL_CMD(stats, NULL, "ESP3 decoder counters", cmd_stats), SHELL_SUBCMD_SET_END);

SHELL_CMD_REGISTER(tcm, &tcm_cmds, "EnOcean TCM", NULL);

int main(void)
{
	if (!device_is_ready(tcm)) {
		out("TCM UART not ready\n");
		return 0;
	}

	esp3_decoder_init(&decoder);
	uart_irq_callback_user_data_set(tcm, uart_isr, NULL);
	uart_irq_rx_enable(tcm);

	out("EnOcean spike: listening on %s\n", tcm->name);

	/* The TCM needs about 100 ms after power-up before it answers. */
	k_msleep(200);
	send_common_command(ESP3_CO_RD_VERSION);
	k_msleep(200);
	send_common_command(ESP3_CO_RD_IDBASE);
	return 0;
}
```

## src/eep.c
```c
/*
 * ERP1 telegrams and EEP decoding, see eep.h.
 */

#include "eep.h"

#include <stddef.h>

static uint32_t be32(const uint8_t *p)
{
	return ((uint32_t)p[0] << 24) | ((uint32_t)p[1] << 16) | ((uint32_t)p[2] << 8) | p[3];
}

bool erp1_parse(const struct esp3_packet *pkt, struct erp1 *out)
{
	const uint8_t *d = esp3_data(pkt);

	/* RORG + at least one data byte + sender ID (4) + status (1) */
	if (pkt->type != ESP3_RADIO_ERP1 || pkt->data_len < 7) {
		return false;
	}

	out->rorg = d[0];
	out->payload = &d[1];
	out->payload_len = (uint8_t)(pkt->data_len - 6);
	out->sender = be32(&d[pkt->data_len - 5]);
	out->status = d[pkt->data_len - 1];

	/* Optional data: sub-telegrams (1), destination ID (4), dBm (1), security level (1) */
	out->has_opt = pkt->opt_len >= 7;
	if (out->has_opt) {
		const uint8_t *o = esp3_opt(pkt);

		out->subtel = o[0];
		out->dest = be32(&o[1]);
		out->dbm = (int8_t)-o[5];
		out->security = o[6];
	} else {
		out->subtel = 0;
		out->dest = EEP_ID_BROADCAST;
		out->dbm = 0;
		out->security = 0;
	}
	return true;
}

/* --- 4BS --- */

/* 4BS payload: DB3 DB2 DB1 DB0 */
static bool is_4bs(const struct erp1 *t)
{
	return t->rorg == EEP_RORG_4BS && t->payload_len == 4;
}

bool eep_4bs_is_teach_in(const struct erp1 *t)
{
	return is_4bs(t) && !(t->payload[3] & 0x08);
}

bool eep_4bs_teach_in(const struct erp1 *t, struct eep *eep, uint16_t *manufacturer)
{
	const uint8_t *p = t->payload;

	if (!eep_4bs_is_teach_in(t) || !(p[3] & 0x80)) {
		return false;
	}
	eep->rorg = EEP_RORG_4BS;
	eep->func = p[0] >> 2;
	eep->type = (uint8_t)(((p[0] & 0x03) << 5) | (p[1] >> 3));
	*manufacturer = (uint16_t)(((p[1] & 0x07) << 8) | p[2]);
	return true;
}

/* Scale raw (0..raw_max) linearly onto min..max degC, in hundredths, rounded. */
static int16_t scale_centi(uint32_t raw, uint32_t raw_max, int32_t min, int32_t max)
{
	int32_t span = (max - min) * 100;
	int32_t v = (int32_t)(((int64_t)raw * span + (int64_t)raw_max / 2) / (int64_t)raw_max);

	return (int16_t)(min * 100 + v);
}

bool eep_a5_02(uint8_t type, const struct erp1 *t, int16_t *centi_c)
{
	/* A5-02-01 is -40..0 degC; each following type moves the 40 K range up by 10 K. */
	if (type < 0x01 || type > 0x0B || !is_4bs(t) || eep_4bs_is_teach_in(t)) {
		return false;
	}
	int32_t min = -40 + 10 * (type - 1);

	/* DB1 counts down: 255 = min, 0 = max */
	*centi_c = scale_centi(255u - t->payload[2], 255u, min, min + 40);
	return true;
}

bool eep_a5_04(uint8_t type, const struct erp1 *t, uint16_t *centi_rh, int16_t *centi_c,
	       bool *has_temp)
{
	int32_t min, max;

	switch (type) {
	case 0x01:
		min = 0;
		max = 40;
		break;
	case 0x02:
		min = -20;
		max = 60;
		break;
	default:
		return false;
	}
	if (!is_4bs(t) || eep_4bs_is_teach_in(t)) {
		return false;
	}

	const uint8_t *p = t->payload;

	if (p[1] > 250 || p[2] > 250) {
		return false;
	}
	*centi_rh = (uint16_t)scale_centi(p[1], 250u, 0, 100);
	*centi_c = scale_centi(p[2], 250u, min, max);
	*has_temp = (p[3] & 0x02) != 0;
	return true;
}

/* --- 1BS --- */

bool eep_d5_00_01(const struct erp1 *t, bool *closed, bool *teach_in)
{
	if (t->rorg != EEP_RORG_1BS || t->payload_len != 1) {
		return false;
	}
	*teach_in = !(t->payload[0] & 0x08);
	*closed = (t->payload[0] & 0x01) != 0;
	return true;
}

/* --- RPS --- */

#define STATUS_T21 0x20
#define STATUS_NU 0x10

bool eep_f6_02(const struct erp1 *t, struct eep_rocker *out)
{
	if (t->rorg != EEP_RORG_RPS || t->payload_len != 1) {
		return false;
	}

	uint8_t b = t->payload[0];

	out->pressed = (b & 0x10) != 0;
	out->known = (t->status & STATUS_NU) != 0;
	if (out->known) {
		out->button = b >> 5;
		out->second = (b & 0x01) != 0;
		out->button2 = (b >> 1) & 0x07;
		out->count = out->second ? 2 : 1;
	} else {
		out->button = 0;
		out->second = false;
		out->button2 = 0;
		out->count = b >> 5;
	}
	return true;
}

const char *eep_rocker_button_name(uint8_t button)
{
	static const char *const names[] = {"A I", "A O", "B I", "B O"};

	return button < 4 ? names[button] : "?";
}

/* --- UTE --- */

bool eep_ute(const struct erp1 *t, struct eep_ute *out)
{
	/* DB6 .. DB0 */
	if (t->rorg != EEP_RORG_UTE || t->payload_len != 7) {
		return false;
	}

	const uint8_t *p = t->payload;

	out->bidirectional = (p[0] & 0x80) != 0;
	out->response_expected = !(p[0] & 0x40);
	out->request = (p[0] >> 4) & 0x03;
	out->command = p[0] & 0x0F;
	out->channels = p[1];
	out->manufacturer = (uint16_t)(((p[3] & 0x07) << 8) | p[2]);
	out->eep.type = p[4];
	out->eep.func = p[5];
	out->eep.rorg = p[6];
	return true;
}

/* --- VLD: D2-01 --- */

int eep_d2_01_command(const struct erp1 *t)
{
	if (t->rorg != EEP_RORG_VLD || t->payload_len < 1) {
		return -1;
	}
	return t->payload[0] & 0x0F;
}

bool eep_d2_01_status(const struct erp1 *t, struct eep_d2_01_status *out)
{
	/* byte 0: PF, PFD, CMD; byte 1: OC, EL, I/O channel; byte 2: LC, output value */
	if (eep_d2_01_command(t) != EEP_D2_01_STATUS_RESPONSE || t->payload_len < 3) {
		return false;
	}

	const uint8_t *p = t->payload;

	out->power_failure = (p[0] & 0x80) != 0;
	out->channel = p[1] & 0x1F;
	out->local_control = (p[2] & 0x80) != 0;
	out->output = p[2] & 0x7F;
	return true;
}

bool eep_d2_01_measurement(const struct erp1 *t, struct eep_d2_01_measurement *out)
{
	/* byte 0: CMD; byte 1: unit (bits 7..5), I/O channel (bits 4..0); bytes 2..5: value */
	if (eep_d2_01_command(t) != EEP_D2_01_MEASUREMENT_RESPONSE || t->payload_len < 6) {
		return false;
	}

	const uint8_t *p = t->payload;

	out->unit = p[1] >> 5;
	out->channel = p[1] & 0x1F;
	out->value = be32(&p[2]);
	return true;
}

const char *eep_d2_01_unit_name(uint8_t unit)
{
	static const char *const names[] = {"Ws", "Wh", "kWh", "W", "kW"};

	return unit < 5 ? names[unit] : "?";
}

/* --- Sending --- */

size_t erp1_encode(uint8_t rorg, const uint8_t *payload, uint8_t len, uint32_t sender,
		   uint8_t status, uint32_t dest, uint8_t *out, size_t out_size)
{
	uint8_t data[1 + 14 + 5];
	/* Sub-telegrams 3, destination, dBm 0xFF (send), security level 0 */
	uint8_t opt[7] = {0x03, (uint8_t)(dest >> 24), (uint8_t)(dest >> 16), (uint8_t)(dest >> 8),
			  (uint8_t)dest, 0xFF, 0x00};
	size_t n = 0;

	if (len > 14) {
		return 0;
	}
	data[n++] = rorg;
	for (uint8_t i = 0; i < len; i++) {
		data[n++] = payload[i];
	}
	data[n++] = (uint8_t)(sender >> 24);
	data[n++] = (uint8_t)(sender >> 16);
	data[n++] = (uint8_t)(sender >> 8);
	data[n++] = (uint8_t)sender;
	data[n++] = status;

	if (dest == EEP_ID_BROADCAST) {
		return esp3_encode(ESP3_RADIO_ERP1, data, (uint16_t)n, NULL, 0, out, out_size);
	}
	return esp3_encode(ESP3_RADIO_ERP1, data, (uint16_t)n, opt, sizeof(opt), out, out_size);
}

size_t eep_eltako_switch(uint32_t sender, bool on, uint8_t *out, size_t out_size)
{
	const uint8_t b = on ? 0x30 : 0x10;

	/* status: T21 = 1, NU = 1 */
	return erp1_encode(EEP_RORG_RPS, &b, 1, sender, 0x30, EEP_ID_BROADCAST, out, out_size);
}

size_t eep_d2_01_set_output(uint32_t sender, uint32_t dest, uint8_t channel, uint8_t output,
			    uint8_t *out, size_t out_size)
{
	/* byte 1: dim value (bits 7..5, 0 = switch at once), I/O channel (bits 4..0) */
	const uint8_t p[3] = {EEP_D2_01_SET_OUTPUT, (uint8_t)(channel & 0x1F),
			      (uint8_t)(output & 0x7F)};

	return erp1_encode(EEP_RORG_VLD, p, sizeof(p), sender, 0x00, dest, out, out_size);
}

size_t eep_d2_01_query_status(uint32_t sender, uint32_t dest, uint8_t channel, uint8_t *out,
			      size_t out_size)
{
	const uint8_t p[2] = {EEP_D2_01_STATUS_QUERY, (uint8_t)(channel & 0x1F)};

	return erp1_encode(EEP_RORG_VLD, p, sizeof(p), sender, 0x00, dest, out, out_size);
}
```

## src/eep.h
```c
/*
 * EnOcean radio telegrams (ERP1, as delivered by ESP3) and a few EnOcean Equipment Profiles.
 *
 * Which EEP a sender uses is only in the telegram for 4BS teach-in (with "LRN type" set) and
 * UTE. RPS (rockers) and 1BS (contacts) never say; the RORG alone has to do.
 *
 * Values are in hundredths (centi-degrees, centi-percent), the unit Matter uses.
 *
 * Plain C without Zephyr dependencies, so it can be unit-tested on the host (tests/host).
 */

#pragma once

#include "esp3.h"

#include <stdbool.h>
#include <stdint.h>

#ifdef __cplusplus
extern "C" {
#endif

/* Radio telegram types (RORG) */
#define EEP_RORG_RPS 0xF6 /* repeated switch: rockers, window handles */
#define EEP_RORG_1BS 0xD5 /* 1 byte: contacts */
#define EEP_RORG_4BS 0xA5 /* 4 bytes: most sensors */
#define EEP_RORG_VLD 0xD2 /* variable length */
#define EEP_RORG_UTE 0xD4 /* universal teach-in */

#define EEP_ID_BROADCAST 0xFFFFFFFFu

struct erp1 {
	uint8_t rorg;
	const uint8_t *payload; /* user data between RORG and sender ID */
	uint8_t payload_len;
	uint32_t sender;
	uint8_t status;
	/* From the optional data, if the module sent it (TCM 310/515 do) */
	bool has_opt;
	uint8_t subtel;
	uint32_t dest;
	int8_t dbm; /* received signal strength, negative */
	uint8_t security;
};

/* Split an ESP3_RADIO_ERP1 packet. False if it is something else or too short. */
bool erp1_parse(const struct esp3_packet *pkt, struct erp1 *out);

/* EEP as RORG-FUNC-TYPE, for example A5-02-05 */
struct eep {
	uint8_t rorg;
	uint8_t func;
	uint8_t type;
};

/* --- 4BS (A5) --- */

/* True if the telegram is a teach-in (LRN bit DB0.3 = 0). */
bool eep_4bs_is_teach_in(const struct erp1 *t);

/*
 * Teach-in variant 3 carries the EEP and manufacturer (LRN type DB0.7 = 1). Returns false for a
 * data telegram or a teach-in without profile (variant 2, older devices).
 */
bool eep_4bs_teach_in(const struct erp1 *t, struct eep *eep, uint16_t *manufacturer);

/* A5-02-01 .. A5-02-0B: temperature, 8 bit, ranges -40..0 up to 60..100 degC. */
bool eep_a5_02(uint8_t type, const struct erp1 *t, int16_t *centi_c);

/*
 * A5-04-01 (0..40 degC) and A5-04-02 (-20..60 degC): humidity and temperature.
 * has_temp is false when the device says it has no temperature sensor (DB0.1 = 0).
 */
bool eep_a5_04(uint8_t type, const struct erp1 *t, uint16_t *centi_rh, int16_t *centi_c,
	       bool *has_temp);

/* --- 1BS (D5) --- */

/* D5-00-01: single input contact. teach_in is true for a teach-in telegram (LRN DB0.3 = 0). */
bool eep_d5_00_01(const struct erp1 *t, bool *closed, bool *teach_in);

/* --- RPS (F6) --- */

/* F6-02-01/02: rocker switch with two rockers (A and B). */
struct eep_rocker {
	bool pressed; /* energy bow: true on press, false on release */
	/* Only for a press with NU = 1 (one or two known buttons): */
	bool known;
	uint8_t button;	 /* 0 = A I, 1 = A O, 2 = B I, 3 = B O */
	bool second;	 /* a second button is pressed too */
	uint8_t button2; /* valid if second */
	/* For a press with NU = 0: number of buttons (0 = none, 3 = three or four) */
	uint8_t count;
};

bool eep_f6_02(const struct erp1 *t, struct eep_rocker *out);

const char *eep_rocker_button_name(uint8_t button);

/* --- UTE (D4) --- */

struct eep_ute {
	uint8_t command;        /* DB6 bits 3..0: 0 = teach-in query, 1 = response */
	bool bidirectional;     /* DB6.7 */
	bool response_expected; /* DB6.6 = 0 */
	uint8_t request;        /* DB6 bits 5..4: 0 = teach-in, 1 = teach-out, 2 = either */
	uint8_t channels;      /* DB5, 0xFF = all */
	uint16_t manufacturer; /* 11 bit */
	struct eep eep;
};

bool eep_ute(const struct erp1 *t, struct eep_ute *out);

/* --- VLD (D2) --- */

/* D2-01 (electronic switches and dimmers) commands, in the low nibble of the first byte */
#define EEP_D2_01_SET_OUTPUT 0x01
#define EEP_D2_01_STATUS_QUERY 0x03
#define EEP_D2_01_STATUS_RESPONSE 0x04
#define EEP_D2_01_MEASUREMENT_RESPONSE 0x07

#define EEP_D2_01_ALL_CHANNELS 0x1E
#define EEP_D2_01_OUTPUT_INVALID 127

/* D2-01 command 4: actuator status response */
struct eep_d2_01_status {
	uint8_t channel;
	uint8_t output; /* 0 = off, 1..100 = %, 127 = not valid */
	bool local_control;
	bool power_failure;
};

/* D2-01 command 7: actuator measurement response */
struct eep_d2_01_measurement {
	uint8_t channel;
	uint8_t unit; /* 0 = Ws, 1 = Wh, 2 = kWh, 3 = W, 4 = kW */
	uint32_t value;
};

/* Command number of a D2-01 telegram, or -1 if it is not VLD. */
int eep_d2_01_command(const struct erp1 *t);

bool eep_d2_01_status(const struct erp1 *t, struct eep_d2_01_status *out);
bool eep_d2_01_measurement(const struct erp1 *t, struct eep_d2_01_measurement *out);

const char *eep_d2_01_unit_name(uint8_t unit);

/* --- Sending --- */

/*
 * Build an ESP3 frame with an ERP1 radio telegram from sender (base ID + offset). With dest =
 * EEP_ID_BROADCAST no optional data is sent; otherwise it is addressed to dest. Returns the
 * frame length, or 0 if out_size is too small.
 */
size_t erp1_encode(uint8_t rorg, const uint8_t *payload, uint8_t len, uint32_t sender,
		   uint8_t status, uint32_t dest, uint8_t *out, size_t out_size);

/*
 * Eltako actuator taught in to a rocker: a press of the right half, 0x30 = on, 0x10 = off.
 * No release, no optional data (as enocean-mqtt did it).
 */
size_t eep_eltako_switch(uint32_t sender, bool on, uint8_t *out, size_t out_size);

/* D2-01 command 1: set output (0 = off, 1..100 = %) on a channel, addressed to dest. */
size_t eep_d2_01_set_output(uint32_t sender, uint32_t dest, uint8_t channel, uint8_t output,
			    uint8_t *out, size_t out_size);

/* D2-01 command 3: ask for the status of a channel; the actuator answers with command 4. */
size_t eep_d2_01_query_status(uint32_t sender, uint32_t dest, uint8_t channel, uint8_t *out,
			      size_t out_size);

#ifdef __cplusplus
}
#endif
```

## src/esp3.c
```c
/*
 * ESP3 framing, see esp3.h.
 */

#include "esp3.h"

#include <string.h>

enum {
	ST_SYNC,
	ST_HEADER,
	ST_PAYLOAD,
	ST_DATA_CRC,
};

uint8_t esp3_crc8(const uint8_t *buf, size_t len)
{
	uint8_t crc = 0;

	for (size_t i = 0; i < len; i++) {
		crc ^= buf[i];
		for (int bit = 0; bit < 8; bit++) {
			crc = (crc & 0x80) ? (uint8_t)((crc << 1) ^ 0x07) : (uint8_t)(crc << 1);
		}
	}
	return crc;
}

void esp3_decoder_init(struct esp3_decoder *dec)
{
	memset(dec, 0, sizeof(*dec));
	dec->state = ST_SYNC;
}

/*
 * The header failed its CRC. The 0x55 that started it was probably noise, so look for another
 * sync byte inside the five header bytes already received and continue from there, as the ESP3
 * specification suggests.
 */
static void resync_in_header(struct esp3_decoder *dec)
{
	for (uint8_t i = 0; i < dec->header_len; i++) {
		if (dec->header[i] == ESP3_SYNC) {
			uint8_t rest = (uint8_t)(dec->header_len - i - 1);

			memmove(dec->header, &dec->header[i + 1], rest);
			dec->header_len = rest;
			dec->state = ST_HEADER;
			return;
		}
	}
	dec->header_len = 0;
	dec->state = ST_SYNC;
}

static bool header_complete(struct esp3_decoder *dec)
{
	const uint8_t *h = dec->header;

	if (esp3_crc8(h, 4) != h[4]) {
		dec->stats.header_crc_errors++;
		resync_in_header(dec);
		return false;
	}

	dec->pkt.data_len = (uint16_t)((h[0] << 8) | h[1]);
	dec->pkt.opt_len = h[2];
	dec->pkt.type = h[3];
	dec->total = (uint16_t)(dec->pkt.data_len + dec->pkt.opt_len);
	dec->pos = 0;
	dec->header_len = 0;

	if (dec->total > ESP3_MAX_PAYLOAD) {
		dec->stats.oversize++;
		dec->state = ST_SYNC;
		return false;
	}
	dec->state = dec->total ? ST_PAYLOAD : ST_DATA_CRC;
	return false;
}

bool esp3_decoder_feed(struct esp3_decoder *dec, uint8_t byte)
{
	switch (dec->state) {
	case ST_SYNC:
		if (byte == ESP3_SYNC) {
			dec->header_len = 0;
			dec->state = ST_HEADER;
		} else {
			dec->stats.skipped_bytes++;
		}
		return false;

	case ST_HEADER:
		dec->header[dec->header_len++] = byte;
		/* After a resync up to 4 bytes are already buffered, never 5. */
		if (dec->header_len == sizeof(dec->header)) {
			return header_complete(dec);
		}
		return false;

	case ST_PAYLOAD:
		dec->pkt.payload[dec->pos++] = byte;
		if (dec->pos == dec->total) {
			dec->state = ST_DATA_CRC;
		}
		return false;

	case ST_DATA_CRC:
		dec->state = ST_SYNC;
		if (esp3_crc8(dec->pkt.payload, dec->total) != byte) {
			dec->stats.data_crc_errors++;
			/* A 0x55 in place of the CRC may be the next frame's start. */
			if (byte == ESP3_SYNC) {
				dec->header_len = 0;
				dec->state = ST_HEADER;
			}
			return false;
		}
		dec->stats.packets++;
		return true;
	}

	dec->state = ST_SYNC;
	return false;
}

size_t esp3_encode(uint8_t type, const uint8_t *data, uint16_t data_len, const uint8_t *opt,
		   uint8_t opt_len, uint8_t *out, size_t out_size)
{
	size_t total = 6u + data_len + opt_len + 1u;

	if (out_size < total) {
		return 0;
	}

	out[0] = ESP3_SYNC;
	out[1] = (uint8_t)(data_len >> 8);
	out[2] = (uint8_t)data_len;
	out[3] = opt_len;
	out[4] = type;
	out[5] = esp3_crc8(&out[1], 4);
	if (data_len) {
		memcpy(&out[6], data, data_len);
	}
	if (opt_len) {
		memcpy(&out[6 + data_len], opt, opt_len);
	}
	out[6 + data_len + opt_len] = esp3_crc8(&out[6], (size_t)data_len + opt_len);
	return total;
}
```
